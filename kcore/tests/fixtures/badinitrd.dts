// SPDX-License-Identifier: GPL-3.0-or-later
// Copyright (C) 2026 Sergey Subbotin <ssubbotin@gmail.com>
/dts-v1/;
/ {
	#address-cells = <2>;
	#size-cells = <2>;

	memory@40000000 {
		device_type = "memory";
		reg = <0x0 0x40000000 0x0 0x10000000>;
	};

	chosen {
		linux,initrd-start = <0x0 0x48001000>;
		linux,initrd-end = <0x0 0x48000000>;
	};
};
