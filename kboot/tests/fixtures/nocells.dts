// SPDX-License-Identifier: GPL-3.0-or-later
// Copyright (C) 2026 Sergey Subbotin <ssubbotin@gmail.com>
/dts-v1/;
/ {
	memory@40000000 {
		device_type = "memory";
		reg = <0x0 0x40000000 0x10000000>;
	};
};
